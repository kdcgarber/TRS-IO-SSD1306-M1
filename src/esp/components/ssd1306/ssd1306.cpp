#include <stdio.h>
#include <string.h>
#include <stdint.h>
#include "freertos/FreeRTOS.h"
#include "freertos/task.h"
#include "driver/i2c.h"
#include "driver/gpio.h"
#include "esp_log.h"
#include "ssd1306.h"

// Constants and framebuffer size are defined in ssd1306.h
static const char *TAG = "SSD1306";
uint8_t framebuffer[FRAMEBUFFER_SIZE];

// 5x7 font data for ASCII characters 32 to 127 + 3 custom symbols
const uint8_t font5x7[111][5] = {
  {0x00,0x00,0x00,0x00,0x00}, // space
  {0x00,0x00,0x5F,0x00,0x00}, // !
  {0x00,0x07,0x00,0x07,0x00}, // "
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  {0x00,0x00,0x00,0x00,0x00}  // space - 142
};  





// I2C setup
void i2c_master_init() {

    i2c_config_t conf = {};
    conf.mode = I2C_MODE_MASTER;
    conf.sda_io_num = I2C_MASTER_SDA_IO;
    conf.sda_pullup_en = GPIO_PULLUP_ENABLE;
    conf.scl_io_num = I2C_MASTER_SCL_IO;
    conf.scl_pullup_en = GPIO_PULLUP_ENABLE;
    conf.master.clk_speed = I2C_MASTER_FREQ_HZ;
    i2c_param_config(I2C_MASTER_NUM, &conf);
    i2c_driver_install(I2C_MASTER_NUM, conf.mode, 0, 0, 0);
}



void ssd1306_send_command(uint8_t cmd) {
    i2c_cmd_handle_t handle = i2c_cmd_link_create();
    i2c_master_start(handle);
    i2c_master_write_byte(handle, (OLED_ADDR << 1) | I2C_MASTER_WRITE, true);
    i2c_master_write_byte(handle, 0x00, true); // Command mode
    i2c_master_write_byte(handle, cmd, true);
    i2c_master_stop(handle);
    i2c_master_cmd_begin(I2C_MASTER_NUM, handle, 1000 / portTICK_PERIOD_MS);
    i2c_cmd_link_delete(handle);
}

void ssd1306_init() {
    const uint8_t init_cmds[] = {
        0xAE, 0x20, 0x00, 0xB0, 0xC8, 0x00, 0x10, 0x40,
        0x81, 0xFF, 0xA1, 0xA6, 0xA8, 0x1F, 0xA4, 0xD3,
        0x00, 0xD5, 0xF0, 0xD9, 0x22, 0xDA, 0x02, 0xDB,
        0x20, 0x8D, 0x14, 0xAF
    };
    for (int i = 0; i < sizeof(init_cmds); i++) {
        ssd1306_send_command(init_cmds[i]);
    }
}

void clear_framebuffer() {
    memset(framebuffer, 0x00, sizeof(framebuffer));
}

void ssd1306_clear_display(void)
{
    clear_framebuffer();
    ssd1306_send_framebuffer();
}


void draw_char_to_buffer(char c, int x, int line) {
    if (c < 32 || c > 142 || x > SCREEN_WIDTH - 5 || line > 3) return;
    const uint8_t *glyph = font5x7[c - 32];
    int offset = line * SCREEN_WIDTH + x;
    for (int i = 0; i < 5; i++) {
        framebuffer[offset + i] = glyph[i];
    }
}




void draw_text(const char* text, int x, int line) {
    //ESP_LOGI(TAG, "text: %s (%i)(%i)", text,x,line);
    while (*text && x < SCREEN_WIDTH - 5) {
        draw_char_to_buffer(*text++, x, line);
        x += 6;
    }
     ssd1306_send_framebuffer();
}

void ssd1306_send_framebuffer() {
    for (uint8_t line = 0; line < 4; line++) {
        ssd1306_send_command(0xB0 + line);
        ssd1306_send_command(0x00);
        ssd1306_send_command(0x10);

        i2c_cmd_handle_t cmd = i2c_cmd_link_create();
        i2c_master_start(cmd);
        i2c_master_write_byte(cmd, (OLED_ADDR << 1) | I2C_MASTER_WRITE, true);
        i2c_master_write_byte(cmd, 0x40, true); // Data mode
        i2c_master_write(cmd, &framebuffer[line * SCREEN_WIDTH], SCREEN_WIDTH, true);
        i2c_master_stop(cmd);
        i2c_master_cmd_begin(I2C_MASTER_NUM, cmd, 1000 / portTICK_PERIOD_MS);
        i2c_cmd_link_delete(cmd);
    }
}

void ssd1306_start_vertical_scroll() {
    ssd1306_send_command(0x29); // Vertical and Right Horizontal Scroll
    ssd1306_send_command(0x00); // Dummy byte
    ssd1306_send_command(0x00); // Start line
    ssd1306_send_command(0x00); // Time interval
    ssd1306_send_command(0x03); // End line
    ssd1306_send_command(0x01); // Vertical offset
    ssd1306_send_command(0x2F); // Activate scroll
}




